## meta-mchp/conf/layer.conf
```bitbake
# We have a conf and classes directory, append to BBPATH
BBPATH .= ":${LAYERDIR}"

# We have a recipes directory, add to BBFILES
BBFILES += "${LAYERDIR}/recipes*/*/*.bb ${LAYERDIR}/recipes*/*/*.bbappend"

BBFILE_COLLECTIONS += "meta-mchp"
BBFILE_PATTERN_meta-mchp := "^${LAYERDIR}/"
BBFILE_PRIORITY_meta-mchp = "10"

LICENSE_PATH += "${LAYERDIR}/licenses"

SIGGEN_EXCLUDE_SAFE_RECIPE_DEPS += " \
  mchp-egt-demo-init->udev-rules-at91 \
  noto-fonts->fontconfig \
"

LAYERSERIES_COMPAT_meta-mchp = "scarthgap"
VIRTUAL-RUNTIME_alsa-state = ""
```

## meta-mchp/conf/machine/sam9x60-curiosity-sd.conf
```bitbake
#@TYPE: Machine
#@Name: MICROCHIP SAM9X60-CURIOSITY SD
#@DESCRIPTION: Machine configuration for Microchip SAM9X60 curiosity board

require include/sam9x60.inc
require conf/distro/include/phosphor-mmc.inc
require conf/machine/include/obmc-bsp-common.inc

MACHINE_FEATURES = "apm alsa ext2 ext3 usbhost usbgadget screen touchscreen"
KERNEL_DEVICETREE = " at91-sam9x60_curiosity.dtb "

IMAGE_FSTYPES:remove = "wic.xz"
IMAGE_FSTYPES:remove = "mmc-ext4-tar"
IMAGE_FSTYPES += " tar.gz wic mchp-sd"

do_image_wic[depends] += "u-boot-mchp:do_deploy"
WKS_FILE = "sdimage-obmc.wks"
IMAGE_BOOT_FILES = "BOOT.BIN u-boot.bin uboot.env sam9x60_curiosity.itb"

UBOOT_MACHINE ?= "sam9x60_curiosity_mmc_defconfig"
UBOOT_ENTRYPOINT = "0x20008000"
UBOOT_LOADADDRESS = "0x20008000"
UBOOT_ENV_SIZE = "0x4000"

AT91BOOTSTRAP_MACHINE ?= "sam9x60_curiosity"

# Needed for wic
EXTRA_IMAGEDEPENDS += "dosfstools-native mtools-native"

# Needed for FIT
MACHINE_ESSENTIAL_EXTRA_RDEPENDS = " dt-overlay-mchp"

INITRAMFS_IMAGE_BUNDLE = "1"

MMC_DEV ?= "mmcblk0"
```

## meta-mchp/conf/machine/sam9x75-curiosity-sd.conf
```bitbake
#@TYPE: Machine
#@Name: MICROCHIP SAM9X75-CURIOSITY SD
#@DESCRIPTION: Machine configuration for Microchip SAM9X75 curiosity board

require include/sam9x75.inc
require conf/distro/include/phosphor-mmc.inc
require conf/machine/include/obmc-bsp-common.inc

MACHINE_FEATURES = "apm alsa ext2 ext3 usbhost usbgadget screen touchscreen"
KERNEL_DEVICETREE = " at91-sam9x75_curiosity.dtb "

IMAGE_FSTYPES:remove = "wic.xz"
IMAGE_FSTYPES:remove = "mmc-ext4-tar"
IMAGE_FSTYPES += " tar.gz wic mchp-sd"

do_image_wic[depends] += "u-boot-mchp:do_deploy"
WKS_FILE = "sdimage-obmc.wks"
IMAGE_BOOT_FILES = "BOOT.BIN u-boot.bin uboot.env sam9x75_curiosity.itb"

UBOOT_MACHINE ?= "sam9x75_curiosity_mmc_defconfig"
UBOOT_ENTRYPOINT = "0x20008000"
UBOOT_LOADADDRESS = "0x20008000"
UBOOT_ENV_SIZE = "0x4000"

AT91BOOTSTRAP_MACHINE ?= "sam9x75_curiosity"

# Needed for wic
EXTRA_IMAGEDEPENDS += "dosfstools-native mtools-native"

# Needed for FIT
MACHINE_ESSENTIAL_EXTRA_RDEPENDS = " dt-overlay-mchp"

INITRAMFS_IMAGE_BUNDLE = "1"

MMC_DEV ?= "mmcblk0"
```

## meta-mchp/conf/machine/sama5d27-wlsom1-ek-sd.conf
```bitbake
#@TYPE: Machine
#@Name: ATMEL SAMA5D2 WLSOM1 EK SD
#@DESCRIPTION: Machine configuration for Atmel/Microchip's evaluation board

require include/sama5d2.inc
require conf/distro/include/phosphor-mmc.inc
require conf/machine/include/obmc-bsp-common.inc

MACHINE_FEATURES = "apm alsa ext2 ext3 usbhost usbgadget touchscreen"
KERNEL_DEVICETREE = " \
		at91-sama5d27_wlsom1_ek.dtb \
		"

IMAGE_FSTYPES:remove = "wic.xz"
IMAGE_FSTYPES:remove = "mmc-ext4-tar"
IMAGE_FSTYPES += " tar.gz wic mchp-sd"

do_image_wic[depends] += "u-boot-mchp:do_deploy"
WKS_FILE = "sdimage-obmc.wks"

IMAGE_BOOT_FILES = "BOOT.BIN u-boot.bin uboot.env sama5d27_wlsom1_ek.itb \
                    "

UBOOT_MACHINE ?= "sama5d27_wlsom1_ek_mmc_defconfig"
UBOOT_ENTRYPOINT = "0x20008000"
UBOOT_LOADADDRESS = "0x20008000"
UBOOT_ENV_SIZE = "0x4000"

AT91BOOTSTRAP_MACHINE ?= "sama5d27_wlsom1_ek"

# Needed for wic
EXTRA_IMAGEDEPENDS += "dosfstools-native mtools-native"

# Needed for FIT
MACHINE_ESSENTIAL_EXTRA_RDEPENDS = " dt-overlay-mchp"

INITRAMFS_IMAGE_BUNDLE = "1"

MMC_DEV ?= "mmcblk0"
```

## meta-mchp/conf/machine/sama5d29-curiosity-sd.conf
```bitbake
#@TYPE: Machine
#@Name: Microchip SAMA5D29-Curiosity micro SD
#@DESCRIPTION: Machine configuration for Microchip's board

require include/sama5d2.inc
require conf/distro/include/phosphor-mmc.inc
require conf/machine/include/obmc-bsp-common.inc

MACHINE_FEATURES = "apm alsa ext2 ext3 usbhost usbgadget touchscreen"
KERNEL_DEVICETREE = " \
		at91-sama5d29_curiosity.dtb \
		"

IMAGE_FSTYPES:remove = "wic.xz"
IMAGE_FSTYPES:remove = "mmc-ext4-tar"
IMAGE_FSTYPES += " tar.gz wic mchp-sd"

do_image_wic[depends] += "u-boot-mchp:do_deploy"
WKS_FILE = "sdimage-obmc.wks"

IMAGE_BOOT_FILES = "BOOT.BIN u-boot.bin uboot.env sama5d29_curiosity.itb \
		   "

UBOOT_MACHINE ?= "sama5d29_curiosity_mmc_defconfig"
UBOOT_ENTRYPOINT = "0x20008000"
UBOOT_LOADADDRESS = "0x20008000"
UBOOT_ENV_SIZE = "0x4000"

AT91BOOTSTRAP_MACHINE ?= "sama5d29_curiosity"

# Needed for wic
EXTRA_IMAGEDEPENDS += "dosfstools-native mtools-native"

# Needed for FIT
MACHINE_ESSENTIAL_EXTRA_RDEPENDS = " dt-overlay-mchp"

INITRAMFS_IMAGE_BUNDLE = "1"

MMC_DEV ?= "mmcblk0"
```

## meta-mchp/conf/machine/sama7d65-curiosity-sd.conf
```bitbake
#@TYPE: Machine
#@Name: Microchip SAMA7D65-CURIOSITY SD
#@DESCRIPTION: Machine configuration for Microchip's evaluation kit board

require include/sama7d65.inc
require conf/distro/include/phosphor-mmc.inc
require conf/machine/include/obmc-bsp-common.inc

MACHINE_FEATURES = "apm alsa ext2 ext3 usbhost usbgadget"
KERNEL_DEVICETREE = " \
		at91-sama7d65_curiosity.dtb \
		"

IMAGE_FSTYPES:remove = "wic.xz"
IMAGE_FSTYPES:remove = "mmc-ext4-tar"
IMAGE_FSTYPES += " tar.gz wic mchp-sd"

do_image_wic[depends] += "u-boot-mchp:do_deploy"
WKS_FILE = "sdimage-obmc.wks"
IMAGE_BOOT_FILES = "BOOT.BIN u-boot.bin uboot.env sama7d65_curiosity.itb"

UBOOT_MACHINE ?= "sama7d65_curiosity_mmc1_defconfig"
UBOOT_ENTRYPOINT = "0x62000000"
UBOOT_LOADADDRESS = "0x62000000"
UBOOT_ENV_SIZE = "0x4000"

AT91BOOTSTRAP_MACHINE ?= "sama7d65_curiosity"

# Needed for wic
EXTRA_IMAGEDEPENDS += "dosfstools-native mtools-native"

# Needed for FIT
MACHINE_ESSENTIAL_EXTRA_RDEPENDS = " dt-overlay-mchp"

MACHINEOVERRIDES =. "sama7d65:"

INITRAMFS_IMAGE_BUNDLE = "1"

MMC_DEV ?= "mmcblk0"
```

## meta-mchp/conf/machine/sama7g5ek-sd.conf
```bitbake
#@TYPE: Machine
#@Name: Microchip SAMA7G5-EK SD
#@DESCRIPTION: Machine configuration for Microchip's evaluation kit board

require include/sama7g5.inc
require conf/distro/include/phosphor-mmc.inc
require conf/machine/include/obmc-bsp-common.inc

MACHINE_FEATURES = "apm alsa ext2 ext3 usbhost usbgadget"
KERNEL_DEVICETREE = " \
		at91-sama7g5ek.dtb \
		"

IMAGE_FSTYPES:remove = "wic.xz"
IMAGE_FSTYPES:remove = "mmc-ext4-tar"
IMAGE_FSTYPES += " tar.gz wic mchp-sd"

do_image_wic[depends] += "u-boot-mchp:do_deploy"
WKS_FILE = "sdimage-obmc.wks"
IMAGE_BOOT_FILES = "BOOT.BIN u-boot.bin uboot.env sama7g5ek.itb"

UBOOT_MACHINE ?= "sama7g5ek_mmc1_defconfig"
UBOOT_ENTRYPOINT = "0x62000000"
UBOOT_LOADADDRESS = "0x62000000"
UBOOT_ENV_SIZE = "0x4000"

AT91BOOTSTRAP_MACHINE ?= "sama7g5ek"
KERNEL_CONFIG_COMMAND = "oe_runmake -C ${S} O=${B} sama7_defconfig"

# Needed for wic
EXTRA_IMAGEDEPENDS += "dosfstools-native mtools-native"

# Needed for FIT
MACHINE_ESSENTIAL_EXTRA_RDEPENDS = " dt-overlay-mchp"

MACHINEOVERRIDES =. "sama7g5ek:"

INITRAMFS_IMAGE_BUNDLE = "1"

MMC_DEV ?= "mmcblk1"
```

## meta-mchp/meta-mchp-distro/conf/distro/mchp-distro.conf
```bitbake
DISTRO = "mchp-distro"
DISTRO_NAME = "Microchip Distro"
DISTRO_VERSION = "1.0"

DISTROOVERRIDES = "${DISTRO}"
TARGET_VENDOR = "-mchp"
SDK_VENDOR = "-mchpsdk"
SDK_VERSION = "${DISTRO_VERSION}"

MCHP_INIT_MANAGER ?= "systemd"
PACKAGE_CLASSES ?= "package_ipk"

MCHP_DEFAULT_DISTRO_FEATURES = ""
DISTRO_FEATURES ?= "${DISTRO_FEATURES_DEFAULT} ${MCHP_DEFAULT_DISTRO_FEATURES}"

PACKAGE_CLASSES ?= "package_ipk"

INIT_MANAGER ?= "${MCHP_INIT_MANAGER}"
```

## meta-mchp/meta-mchp-mpu/conf/machine/sama7d65-curiosity-sd.conf
```bitbake
#@TYPE: Machine
#@Name: Microchip SAMA7D65-CURIOSITY SD
#@DESCRIPTION: Machine configuration for Microchip SAMA7D65 curiosity sd board

require include/sama7d65.inc
require conf/distro/include/phosphor-mmc.inc
require conf/machine/include/obmc-bsp-common.inc

MACHINE_FEATURES = "apm alsa ext2 ext3 usbhost usbgadget"
KERNEL_DEVICETREE = "microchip/at91-sama7d65_curiosity.dtb"
DT_MACHINE ?= "sama7d65_curiosity"

IMAGE_FSTYPES:remove = "wic.xz"
IMAGE_FSTYPES:remove = "mmc-ext4-tar"
IMAGE_FSTYPES += " tar.gz wic mchp-sd"

WKS_FILE = "sdimage-obmc.wks"
IMAGE_BOOT_FILES = "BOOT.BIN u-boot.bin uboot.env sama7d65_curiosity.itb"

UBOOT_MACHINE ?= "sama7d65_curiosity_mmc1_defconfig"
UBOOT_ENTRYPOINT = "0x62000000"
UBOOT_LOADADDRESS = "0x62000000"
UBOOT_ENV_SIZE = "0x4000"

# Needed for wic
EXTRA_IMAGEDEPENDS += "dosfstools-native mtools-native"

MACHINE_ESSENTIAL_EXTRA_RDEPENDS += " dt-overlay-mchp"

# Add deploy functions to the wic image dependency
do_image_wic[depends] += " u-boot-mchp:do_deploy"
do_image_wic[depends] += " dt-overlay-mchp:do_deploy"

MACHINEOVERRIDES =. "sama7d65:"

INITRAMFS_IMAGE_BUNDLE = "1"

MMC_DEV ?= "mmcblk0"
```

## meta-mchp/meta-mchp-mpu/conf/machine/sama7g5ek-sd.conf
```bitbake
#@TYPE: Machine
#@Name: Microchip SAMA7G5-EK SD
#@DESCRIPTION: Machine configuration for Microchip SAMA7G5 sd evaluation kit

require include/sama7g5.inc
require conf/distro/include/phosphor-mmc.inc
require conf/machine/include/obmc-bsp-common.inc

MACHINE_FEATURES = "apm alsa ext2 ext3 usbhost usbgadget"
KERNEL_DEVICETREE = "microchip/at91-sama7g5ek.dtb"
DT_MACHINE ?= "sama7g5ek"

IMAGE_FSTYPES:remove = "wic.xz"
IMAGE_FSTYPES:remove = "mmc-ext4-tar"
IMAGE_FSTYPES += " tar.gz wic mchp-sd"

WKS_FILE = "sdimage-obmc.wks"
IMAGE_BOOT_FILES = "BOOT.BIN u-boot.bin uboot.env sama7g5ek.itb"

UBOOT_MACHINE ?= "sama7g5ek_mmc1_defconfig"
UBOOT_ENTRYPOINT = "0x62000000"
UBOOT_LOADADDRESS = "0x62000000"
UBOOT_ENV_SIZE = "0x4000"

# Needed for wic
EXTRA_IMAGEDEPENDS += "dosfstools-native mtools-native"

MACHINE_ESSENTIAL_EXTRA_RDEPENDS += " dt-overlay-mchp"

# Add deploy functions to the wic image dependency
do_image_wic[depends] += " u-boot-mchp:do_deploy"
do_image_wic[depends] += " dt-overlay-mchp:do_deploy"

MACHINEOVERRIDES =. "sama7g5ek:"

INITRAMFS_IMAGE_BUNDLE = "1"

MMC_DEV ?= "mmcblk1"
```

## meta-mchp/meta-mchp-mpu/meta-mchp-mpu-bsp/conf/machine/sam9x60-curiosity-sd.conf
```bitbake
#@TYPE: Machine
#@Name: MICROCHIP SAM9X60-CURIOSITY SD
#@DESCRIPTION: Machine configuration for Microchip SAM9X60 curiosity sd board

require include/sam9x60.inc
require conf/distro/include/phosphor-mmc.inc
require conf/machine/include/obmc-bsp-common.inc

MACHINE_FEATURES += " wifi"

KERNEL_DEVICETREE = "microchip/at91-sam9x60_curiosity.dtb"
DT_MACHINE ?= "sam9x60_curiosity"

IMAGE_FSTYPES:remove = "wic.xz"
IMAGE_FSTYPES:remove = "mmc-ext4-tar"
IMAGE_FSTYPES += " tar.gz wic mchp-sd"

WKS_FILE = "sdimage-obmc.wks"

IMAGE_BOOT_FILES = "BOOT.BIN u-boot.bin uboot.env sam9x60_curiosity.itb"

UBOOT_MACHINE ?= "sam9x60_curiosity_mmc_defconfig"
UBOOT_ENTRYPOINT = "0x20008000"
UBOOT_LOADADDRESS = "0x20008000"
UBOOT_ENV_SIZE = "0x4000"

# Needed for wic
EXTRA_IMAGEDEPENDS += "dosfstools-native mtools-native"

MACHINE_ESSENTIAL_EXTRA_RDEPENDS += " dt-overlay-mchp"

# Add deploy functions to the wic image dependency
do_image_wic[depends] += " u-boot-mchp:do_deploy"
do_image_wic[depends] += " dt-overlay-mchp:do_deploy"

MACHINEOVERRIDES =. "mpuall:sam9x60_curiosity:"

INITRAMFS_IMAGE_BUNDLE = "1"

MMC_DEV ?= "mmcblk0"
```

## meta-mchp/meta-mchp-mpu/meta-mchp-mpu-bsp/conf/machine/sama5d27-som1-ek-sd.conf
```bitbake
#@TYPE: Machine
#@Name: MICROCHIP SAMA5D2-SOM1-EK SD
#@DESCRIPTION: Machine configuration for Microchip SAMA5D2-SOM1 sd evaluation kit

require include/sama5d2.inc
require conf/distro/include/phosphor-mmc.inc
require conf/machine/include/obmc-bsp-common.inc

MACHINE_FEATURES = "apm alsa ext2 ext3 usbhost usbgadget touchscreen wifi"
KERNEL_DEVICETREE = "microchip/at91-sama5d27_som1_ek.dtb"
DT_MACHINE ?= "sama5d27_som1_ek"

IMAGE_FSTYPES:remove = "wic.xz"
IMAGE_FSTYPES:remove = "mmc-ext4-tar"
IMAGE_FSTYPES += " tar.gz wic mchp-sd"

WKS_FILE = "sdimage-obmc.wks"

IMAGE_BOOT_FILES = "BOOT.BIN u-boot.bin uboot.env sama5d27_som1_ek.itb"

UBOOT_MACHINE ?= "sama5d27_som1_ek_mmc_defconfig"
UBOOT_ENTRYPOINT = "0x20008000"
UBOOT_LOADADDRESS = "0x20008000"
UBOOT_ENV_SIZE = "0x4000"

# Needed for wic
EXTRA_IMAGEDEPENDS += "dosfstools-native mtools-native"

MACHINE_ESSENTIAL_EXTRA_RDEPENDS += " dt-overlay-mchp"

# Add deploy functions to the wic image dependency
do_image_wic[depends] += " u-boot-mchp:do_deploy"
do_image_wic[depends] += " dt-overlay-mchp:do_deploy"

MACHINEOVERRIDES =. "mpuall:sama5d27_som1_ek:"

INITRAMFS_IMAGE_BUNDLE = "1"

MMC_DEV ?= "mmcblk0"
```

## meta-mchp/meta-mchp-mpu/scripts/lib/wic/canned-wks/sdimage-obmc.wks
```
part /boot-a --source bootimg-partition --ondisk mmcblk0 --fstype=vfat --label boot-a --active --align 4 --size 16 --no-fstab-update
part /boot-b --source bootimg-partition --ondisk mmcblk0 --fstype=vfat --label boot-b --align 4 --size 16 --no-fstab-update
part /root-a --source rootfs --ondisk mmcblk0 --fstype=ext4 --label rofs-a --align 4 --size 300 --no-fstab-update
part /root-b --source rootfs --ondisk mmcblk0 --fstype=ext4 --label rofs-b --align 4 --size 300 --no-fstab-update
part --ondisk mmcblk0 --fstype=ext4 --label rwfs --align 4 --size 1024 --no-fstab-update
```
